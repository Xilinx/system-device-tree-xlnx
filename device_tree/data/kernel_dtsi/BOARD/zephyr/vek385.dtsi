// SPDX-License-Identifier: Apache-2.0
/*
 * (C) Copyright 2026, Advanced Micro Devices, Inc.
 *
 */

&gem0 {
	gem0_mac: ethernet_mac {
		phy-handle = <&phy0>;
	};

	gem0_mdio: mdio {
		compatible = "xlnx,gem-mdio";
		status = "okay";
		#address-cells = <1>;
		#size-cells = <0>;

		phy0: ethernet-phy@1 {
			reg = <0x1>;
			compatible = "ti,dp83867";
			ti,rx-internal-delay = <0x8>;
			ti,tx-internal-delay = <0xa>;
			ti,interface-type = "rgmii-id";
			status="okay";
		};
	};
};

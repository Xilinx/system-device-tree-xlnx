// SPDX-License-Identifier: Apache-2.0
/*
 * (C) Copyright 2026, Advanced Micro Devices, Inc.
 *
 */

&axi_quad_spi_0 {
	status = "okay";

	flash@0 {
		compatible = "jedec,spi-nor";
		reg = <0>;
		spi-max-frequency = <8000000>;
		jedec-id = [20 bb 18]; /* n25q256 */
		size = <0x8000000>;
		has-dpd;
		t-enter-dpd = <10000>;
		t-exit-dpd = <35000>;
	};
};

// SPDX-License-Identifier: Apache-2.0
/*
 * (C) Copyright 2026, Advanced Micro Devices, Inc.
 *
 */

&axi_enet {

	axi_ethernet: ethernet-mac {
		phy-handle = <&axi_ethernetphy1>;
	};

	axi_ethernet_mdio: mdio {
		#address-cells = <1>;
		#size-cells = <0>;
		compatible = "xlnx,axi-ethernet-1.00.a-mdio";

		axi_ethernetphy1: phy@1 {
			device_type = "ethernet-phy";
			compatible = "ti,dp83867";
			ti,rx-internal-delay = <3>;
			ti,tx-internal-delay = <3>;
			ti,interface-type = "rgmii-id";
			reg = <1>;
		};
	};
};

// SPDX-License-Identifier: GPL-2.0
/*
 * dts file for AMD Versal XC2VP3602
 *
 * Copyright (C) 2026, Advanced Micro Devices, Inc.
 *
 * Michal Simek <michal.simek@amd.com>
 */

/ {
	compatible = "xlnx,versal-xc2vp3602";
	model = "AMD Versal Gen XC2VP3602";
};

// SPDX-License-Identifier: GPL-2.0
/*
 * dts file for AMD Versal Gen 2 VNC (T50)
 *
 * Copyright (C) 2024, Advanced Micro Devices, Inc.
 *
 * Michal Simek <michal.simek@amd.com>
 */

/ {
	compatible = "amd,versal2";
	model = "AMD Versal Gen 2 Silicon EL2";

	chosen {
		bootargs = "earlycon=pl011,mmio32,0xf1920000 console=ttyAMA0,115200";
		stdout-path = "serial0:115200n8";
	};
};

/* GPIO leds/dips/pushPB, SMA to PL */
&mmi_10gbe {
	phy-mode = "10gbase-r";
	fixed-link {
		speed = <10000>;
		duplex = "full";
	};
};
